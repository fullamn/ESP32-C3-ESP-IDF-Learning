## mechanics-base/main/Kconfig.projbuild
```kconfig
menu "Main Configuration"

    orsource "$IDF_PATH/examples/common_components/env_caps/$IDF_TARGET/Kconfig.env_caps"

    choice MECHANICS_SIGNAL_TYPE
        bool "Signal Type"
        default MECHANICS_TTL
        help
            Determines what signal type is used to control the motor. TTL only allows for binary motor operation, while SDM allows rudimentary speed control.

    config MECHANICS_TTL
        bool "TTL"

    config MECHANICS_SDM
        bool "SDM"

    config MECHANICS_NONE
        bool "NONE"

    endchoice

    if MECHANICS_TTL

    config MECHANICS_PIN0_GPIO_NUM
        int "Pin 0"
        default 0
        range ENV_GPIO_RANGE_MIN ENV_GPIO_OUT_RANGE_MAX
        help
            GPIO pin connected to Pin 0 of the motor.

    config MECHANICS_PIN1_GPIO_NUM
        int "Pin 1"
        default 1
        range ENV_GPIO_RANGE_MIN ENV_GPIO_OUT_RANGE_MAX
        help
            GPIO pin connected to Pin 1 of the motor.

    config MECHANICS_CLW_PIN
        int  "Clockwise Pin"
        help
            Pin to set exclusively high to turn motor clockwise.
        default 0
        range 0 1
    endif

    if MECHANICS_SDM

    config MECHANICS_SDM_GPIO_NUM
        int "Speed Pin (SDM)"
        default 0
        range ENV_GPIO_RANGE_MIN ENV_GPIO_OUT_RANGE_MAX
        help
            GPIO pin used to transmit the SDM signal to motor for speed control.

    config MECHANICS_DIR_GPIO_NUM
        int "Direction Pin (GPIO)"
        default 1
        range ENV_GPIO_RANGE_MIN ENV_GPIO_OUT_RANGE_MAX
        help
            GPIO pin used to transmit a TTL signal to motor for direction control.

    config MECHANICS_DEFAULT_SDM_DUTY
        int "Speed Percentage (%)"
        default 75
        range 0 100
        help
            Default SDM duty cycle to control the motor's speed.

    config MECHANICS_CLW_LVL
        int  "TTL Level for Clockwise Direction"
        help
            Level to set direction control pin to turn clockwise.
        default 0
        range 0 1

    endif
endmenu
```
